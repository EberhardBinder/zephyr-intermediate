## twister-out/native_sim_native/host_gnu/zephyr-intermediate/tests/temp_alarm/homework.unit.temp_alarm.ordered/Kconfig/boards/Kconfig.sysbuild.tmp
```kconfig
# Load Sysbuild board Kconfig descriptions.
osource "/home/bindere/iomico/intermediate/zephyr/boards/native/native_sim/Kconfig.sysbuild"
```

## twister-out/native_sim_native/host_gnu/zephyr-intermediate/tests/temp_alarm/homework.unit.temp_alarm/Kconfig/arch/Kconfig.tmp
```kconfig
# Load Zephyr Arch Kconfig descriptions.
osource "/home/bindere/iomico/intermediate/zephyr/arch/rx/Kconfig"
osource "/home/bindere/iomico/intermediate/zephyr/arch/x86/Kconfig"
osource "/home/bindere/iomico/intermediate/zephyr/arch/xtensa/Kconfig"
osource "/home/bindere/iomico/intermediate/zephyr/arch/sparc/Kconfig"
osource "/home/bindere/iomico/intermediate/zephyr/arch/riscv/Kconfig"
osource "/home/bindere/iomico/intermediate/zephyr/arch/posix/Kconfig"
osource "/home/bindere/iomico/intermediate/zephyr/arch/openrisc/Kconfig"
osource "/home/bindere/iomico/intermediate/zephyr/arch/mips/Kconfig"
osource "/home/bindere/iomico/intermediate/zephyr/arch/arm64/Kconfig"
osource "/home/bindere/iomico/intermediate/zephyr/arch/arm/Kconfig"
osource "/home/bindere/iomico/intermediate/zephyr/arch/arc/Kconfig"
```

## twister-out/native_sim_native/host_gnu/zephyr-intermediate/tests/temp_alarm/homework.unit.temp_alarm/Kconfig/boards/Kconfig.defconfig
```kconfig
# Load Zephyr board defconfig descriptions.
osource "/home/bindere/iomico/intermediate/zephyr/boards/native/native_sim/Kconfig.defconfig"
```

## twister-out/native_sim_native/host_gnu/zephyr-intermediate/tests/temp_alarm/homework.unit.temp_alarm/Kconfig/boards/Kconfig.native_sim
```kconfig
# Load board Kconfig descriptions.
osource "/home/bindere/iomico/intermediate/zephyr/boards/native/native_sim/Kconfig.native_sim"
```
